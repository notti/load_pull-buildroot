## Config.in
```kconfig
source "$BR2_EXTERNAL/package/python-smmap/Config.in"
source "$BR2_EXTERNAL/package/emce/Config.in"
```

## package/emce/Config.in
```kconfig
config BR2_PACKAGE_EMCE
	bool "emce"
	depends on BR2_LINUX_KERNEL
	help
            Emce module to access the fpga

comment "emce needs a Linux kernel to be built"
	depends on !BR2_LINUX_KERNEL
```

## package/python-smmap/Config.in
```kconfig
config BR2_PACKAGE_PYTHON_SMMAP
	bool "python-smmap"
	depends on BR2_PACKAGE_PYTHON
	help
          smmap
```

## package/python-twisted/Config.in
```kconfig
config BR2_PACKAGE_PYTHON_TWISTED
	bool "python-twisted"
	depends on BR2_PACKAGE_PYTHON && BR2_PACKAGE_PYTHON_ZOPE_INTERFACE
	help
          python - twisted
```

## package/python-zope-interface/Config.in
```kconfig
config BR2_PACKAGE_PYTHON_ZOPE_INTERFACE
	bool "python-zope-interface"
	depends on BR2_PACKAGE_PYTHON
	help
          zope.interface
```
